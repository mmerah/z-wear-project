## CMakeLists.txt
```
# SPDX-License-Identifier: Apache-2.0

cmake_minimum_required(VERSION 3.13.1)
find_package(Zephyr REQUIRED HINTS $ENV{ZEPHYR_BASE})
project(hmac)

FILE(GLOB app_sources src/*.c)
target_sources(app PRIVATE ${app_sources})
```

## prj.conf
```kconfig
CONFIG_ZTEST=y
CONFIG_ZTEST_STACKSIZE=5120
```

## src/main.c
```c
/*
 * Copyright (c) 2021
 *
 * SPDX-License-Identifier: Apache-2.0
 */

/// @file main.c

/**
 * @brief Tests for the sensor interface module
 *
 * Verify sensor handler commands and abstractions
 *
 * @defgroup sensor_interface_tests SENS
 * @ingroup all_tests
 * @{
 * @}
 */

#include <ztest.h>

/* Code tested */
#include "../../../../src/sensors/sensor_interface.h"
#include "../../../../src/sensors/sensor_interface.c"

/************************************************
 *  ... SENSOR CONTROL INTERFACES
 ***********************************************/

extern void test_start_all_sensors(void);
extern void test_fail_bas_start(void);

extern void test_stop_all_sensors(void);
extern void test_fail_bas_stop(void);

/************************************************
 *  ... NOTIFYING INTERFACES
 ***********************************************/

extern void test_bas_notify(void);

/************************************************
 *  ... SENSOR SCHEDULER
 ***********************************************/

//extern void test_sensor_handler_init(void);

/************************************************
 *  ... TEST MAIN
 ***********************************************/

/*test case main entry*/
void test_main(void)
{
    ztest_test_suite(test_interface,
                     ztest_unit_test(test_start_all_sensors),
                     ztest_unit_test(test_fail_bas_start),
                     ztest_unit_test(test_stop_all_sensors),
                     ztest_unit_test(test_fail_bas_stop),
                     ztest_unit_test(test_bas_notify));

    ztest_run_test_suite(test_interface);
}
```

## src/test_notify_interface.c
```c
/*
 * Copyright (c) 
 *
 * SPDX-License-Identifier: Apache-2.0
 */

/// @file test_notify_interface.c

/**
 * @addtogroup sensor_interface_tests
 * @{
 */

/* ZTEST library */
#include <ztest.h>

/* Fake functions */
#include "util_test_sensor.h"

/************************************************
 *  ...TESTS DECLARATIONS
 ***********************************************/

/**
 * @brief Test bas notify
 * @details test bas_notify() with a battery level.
 * The function should return 0.
 * @see bas_notify()
 */
void test_bas_notify(void)
{
    int16_t fake_batt_level = 90;
    zassert_ok(bas_notify(fake_batt_level), "Failed BAS notify interface");
}

/**
 * @}
 */
```

## src/test_sensor_control.c
```c
/*
 * Copyright (c) 
 *
 * SPDX-License-Identifier: Apache-2.0
 */

/// @file test_sensor_control.c

/**
 * @addtogroup sensor_interface_tests
 * @{
 */

/* ZTEST library */
#include <ztest.h>

/* Fake functions */
#include "util_test_sensor.h"

/************************************************
 *  ...TESTS DECLARATIONS
 ***********************************************/

/**
 * @brief Test start all sensors
 * @details test start_all_sensors() in case
 * all sensors can be started successfully. Should
 * return 0.
 * @see start_all_sensors()
 */
void test_start_all_sensors(void)
{
    enable_batt();
    zassert_ok(start_all_sensors(), "Could not start all sensors");
}

/**
 * @brief Test start all sensors, no battery
 * @details test start_all_sensors() in case
 * the battery sensor cannot be started successfully.
 * Should return -EINVAL.
 * @see start_all_sensors()
 */
void test_fail_bas_start(void)
{
    disable_batt();
    zassert_equal(start_all_sensors(), -EINVAL,
                  "Started sensors despite battery sensor disabled");
}

/**
 * @brief Test stops all sensors
 */
void test_stop_all_sensors(void)
{
    enable_batt();
    zassert_ok(stop_all_sensors(), "Could not stop all sensors");
}

/**
 * @brief Test stop all sensors, battery sensor disabled
 */
void test_fail_bas_stop(void)
{
    disable_batt();
    zassert_equal(stop_all_sensors(), -EINVAL,
                  "stoped sensors despite battery sensor disabled");
}
```

## src/util_test_sensor.c
```c
/*
 * Copyright (c) 
 *
 * SPDX-License-Identifier: Apache-2.0
 */

/// @file util_test_sensor.c

#include "util_test_sensor.h"

/************************************************
 *  ...STUBS
 ***********************************************/
int z_impl_k_poll(struct k_poll_event *events, int num_events,
                  k_timeout_t timeout)
{
    return 0;
}

int bt_bas_set_battery_level(uint8_t batt)
{
    return 0;
}

/************************************************
 *  ...MOCKS UTILITIES
 ***********************************************/
static int battery_sensor_ok;

void enable_batt(void)
{
    battery_sensor_ok = 0;
}
void disable_batt(void)
{
    battery_sensor_ok = -1;
}

/************************************************
 *  ...MOCKS
 ***********************************************/
int bas_start(void)
{
    return battery_sensor_ok;
}

int bas_stop(void)
{
    return battery_sensor_ok;
}
```

## src/util_test_sensor.h
```c
/*
 * Copyright (c) 2021
 *
 * SPDX-License-Identifier: Apache-2.0
 */

/// @file util_test_sensor.h

#ifndef _UTIL_TEST_SENSOR_H
#define _UTIL_TEST_SENSOR_H

#include <zephyr.h>
#include <stdint.h>

/************************************************
 *  ...STUBS DECLARATIONS
 ***********************************************/
int z_impl_k_poll(struct k_poll_event *events, int num_events,
                  k_timeout_t timeout);

int bt_bas_set_battery_level(uint8_t batt);

/************************************************
 *  ...MOCKS UTILITIES
 ***********************************************/
void enable_batt(void);
void disable_batt(void);

#endif /* _UTIL_TEST_SENSOR_H */
```
