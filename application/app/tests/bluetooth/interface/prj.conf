## CMakeLists.txt
```
# SPDX-License-Identifier: Apache-2.0

cmake_minimum_required(VERSION 3.13.1)
find_package(Zephyr REQUIRED HINTS $ENV{ZEPHYR_BASE})
project(ble_init)

FILE(GLOB app_sources src/*.c)
target_sources(app PRIVATE ${app_sources})
```

## prj.conf
```kconfig
CONFIG_ZTEST=y
CONFIG_ZTEST_STACKSIZE=5120

#CONFIG_LOG=y
```

## src/main.c
```c
/*
 * Copyright (c) 
 *
 * SPDX-License-Identifier: Apache-2.0
 */

/// @file main.c

/**
 * @brief Tests for the BLE interface module
 *
 * Verify that the BLE interface module function as
 * expected.
 *
 * @defgroup ble_tests BLE
 * @ingroup all_tests
 * @{
 * @}
 */

/* ZTEST library */
#include <ztest.h>
#include <zephyr.h>
#include <stdint.h>

/* Code tested */
#include "../../../../src/ble/ble_interface.h"
#include "../../../../src/ble/ble_interface.c"

/************************************************
 *  ... STUBS
 ***********************************************/
#define SYS_REBOOT_COLD 1
void sys_reboot(int type) {}

int bt_conn_set_security(struct bt_conn *conn, bt_security_t sec)
{
    return 0;
}

/************************************************
 *  ... FAKES
 ***********************************************/
/* FAKE SEMAPHORES */
K_SEM_DEFINE(ble_conn, 0, 1);
K_SEM_DEFINE(ble_deconn, 0, 1);
K_SEM_DEFINE(ble_init_c, 0, 1);

/* Faked functions */
#include "util_test_ble.h"

/* FAKE CONNEXION */
struct bt_conn *fakeconnexion;

extern struct k_sem ble_timeout;

/************************************************
 *  ... MOCKS
 ***********************************************/

/************************************************
 *  ... UTILITIES
 ***********************************************/
#define STACK_SIZE 2048
#define MY_PRIORITY 4
static K_THREAD_STACK_DEFINE(tstack, STACK_SIZE);
static struct k_thread tdata;

/************************************************
 *  ... TESTS DECLARATIONS
 ***********************************************/

/**
 * @brief Test BLE layer initialization
 * @details test ble_layer_init function
 * @see ble_layer_init()
 */
static void test_ble_layer_init(void)
{
    zassert_ok(ble_layer_init(), "BLE Layer did not initialize.");
}

/**
 * @brief Test BLE layer pause advertising
 * @details test ble_layer_pause function
 * @see ble_layer_pause()
 */
static void test_ble_layer_pause(void)
{
    zassert_ok(ble_layer_pause(), "BLE Layer did not pause.");
}

/**
 * @brief Test BLE layer resume advertising
 * @details test ble_layer_resume function
 * @see ble_layer_resume()
 */
static void test_ble_layer_resume(void)
{
    zassert_ok(ble_layer_resume(), "BLE Layer did not pause.");
}

/**
 * @brief Test BLE connection semaphore
 * @details test connected callback function
 * @see connected()
 */
static void test_ble_connection(void)
{
    set_bt_conn_info();
    connected(fakeconnexion, 0);
    zassert_equal(k_sem_count_get(&ble_conn), 1, "BLE connection semaphore not given");
    int err = k_sem_take(&ble_conn, K_MSEC(0));
    if (!err)
    {
        zassert_equal(k_sem_count_get(&ble_conn), 0, "BLE connection semaphore count wrong");
    }
    else
    {
        zassert_unreachable("BLE connection semaphore was not taken");
    }
}

/**
 * @brief Test BLE connection no bt_conn_info
 * @details test connected callback function
 * @see connected()
 */
static void test_ble_connection_noinfo(void)
{
    unset_bt_conn_info();
    connected(fakeconnexion, 0);
    zassert_equal(k_sem_count_get(&ble_conn), 1, "BLE connection semaphore not given");
    int err = k_sem_take(&ble_conn, K_MSEC(0));
    if (!err)
    {
        zassert_equal(k_sem_count_get(&ble_conn), 0, "BLE connection semaphore count wrong");
    }
    else
    {
        zassert_unreachable("BLE connection semaphore was not taken");
    }
}

/**
 * @brief Test BLE connection failing
 * @details test connected callback function
 * @see connected()
 */
static void test_ble_connection_failed(void)
{
    set_bt_conn_info();
    connected(fakeconnexion, 1);
    int err = k_sem_take(&ble_conn, K_MSEC(0));
    if (!err)
    {
        zassert_unreachable("BLE connection semaphore was not taken");
    }
    else
    {
        zassert_equal(k_sem_count_get(&ble_conn), 0, "BLE connection semaphore count wrong");
    }
}

/**
 * @brief Test BLE deconnection semaphore
 * @details test disconnected callback function
 * @see disconnected()
 */
static void test_ble_deconnection(void)
{
    disconnected(fakeconnexion, 0);
    zassert_equal(k_sem_count_get(&ble_deconn), 1, "BLE disconnected semaphore not given");
    int err = k_sem_take(&ble_deconn, K_MSEC(0));
    if (!err)
    {
        zassert_equal(k_sem_count_get(&ble_deconn), 0, "BLE disconnected semaphore count wrong");
    }
    else
    {
        zassert_unreachable("BLE disconnected semaphore was not taken");
    }
}

/**
 * @brief Test BLE MTU exchange
 * @details test exchange_func function
 * @see exchange_func()
 */
static void test_exchange_mtu(void)
{
    struct bt_gatt_exchange_params *param;
    set_bt_conn_info();
    exchange_func(fakeconnexion, 0, param);
    zassert_ok(0, "Stuck in exchange function");

    unset_bt_conn_info();
    exchange_func(fakeconnexion, 0, param);
    zassert_ok(0, "Stuck in exchange function error handling");
}

/**
 * @brief Test BLE Timeout timer
 * @details test ble_timeout_timer_handler function
 * @see ble_timeout_timer_handler()
 */
static void test_ble_timeout_timer_handler(void)
{
    struct k_timer *dummy;
    ble_timeout_timer_handler(dummy);
    zassert_true(k_sem_count_get(&ble_timeout) == 1, "Ble timeout semaphore not given.");
}

/**
 * @brief Test BLE Starting timeout
 * @details test ble_timeout_start function
 * @see ble_timeout_start()
 */
static void test_ble_timeout_start(void)
{
    zassert_ok(ble_timeout_start(), "Could not start the ble timeout subsystem");
}

/**
 * @brief Test BLE Timeout handler thread
 */
/**
 * @brief Test BLE Timeout handler thread
 * @details test ble_handler thread access
 * @see ble_handler()
 */
static void test_ble_handler(void)
{
    k_sem_give(&ble_timeout);
    k_thread_create(&tdata, tstack, STACK_SIZE,
                    ble_handler, NULL, NULL, NULL,
                    MY_PRIORITY,
                    K_INHERIT_PERMS, K_NO_WAIT);
    k_sleep(K_USEC(200));
    zassert_true(k_sem_count_get(&ble_timeout) == 0, "Ble timeout handler was not executed");
}

/************************************************
 *  ... TEST MAIN
 ***********************************************/

/*test case main entry*/
void test_main(void)
{
    ztest_test_suite(test_interface,
                     ztest_unit_test(test_ble_layer_init),
                     ztest_unit_test(test_ble_layer_pause),
                     ztest_unit_test(test_ble_layer_resume),
                     ztest_unit_test(test_ble_connection),
                     ztest_unit_test(test_ble_connection_noinfo),
                     ztest_unit_test(test_ble_connection_failed),
                     ztest_unit_test(test_ble_deconnection),
                     ztest_unit_test(test_exchange_mtu),
                     ztest_unit_test(test_ble_timeout_timer_handler),
                     ztest_unit_test(test_ble_timeout_start),
                     ztest_unit_test(test_ble_handler));

    ztest_run_test_suite(test_interface);
}
```

## src/util_test_ble.c
```c
/*
 * Copyright (c) 
 *
 * SPDX-License-Identifier: Apache-2.0
 */

/// @file util_test_ble.c

#include "util_test_ble.h"

/************************************************
 *  ... STUBS DECLARATION
 ***********************************************/
static int bt_conn_get_info_mock;

void set_bt_conn_info(void)
{
    bt_conn_get_info_mock = 0;
}

void unset_bt_conn_info(void)
{
    bt_conn_get_info_mock = -1;
}

int bt_conn_get_info(const struct bt_conn *conn, struct bt_conn_info *info)
{
    /* Stubs the connexion info */
    info->role = 1;
    info->le.interval = 36;
    info->le.latency = 0;
    info->le.timeout = 42;
    return bt_conn_get_info_mock;
}

void bt_conn_cb_register(struct bt_conn_cb *cb)
{
}

int bt_le_adv_start(const struct bt_le_adv_param *param,
                    const struct bt_data *ad, size_t ad_len,
                    const struct bt_data *sd, size_t sd_len)
{
    return 0;
}

int bt_le_adv_stop(void)
{
    return 0;
}

const bt_addr_le_t *bt_conn_get_dst(const struct bt_conn *conn)
{
    bt_addr_le_t *fake_addr_le_t;
    return fake_addr_le_t;
}

int bt_gatt_exchange_mtu(struct bt_conn *conn,
                         struct bt_gatt_exchange_params *params)
{
    return 0;
}

static int bt_init(void)
{
    return 0;
}

static bt_ready_cb_t ready_cb;
int bt_enable(bt_ready_cb_t cb)
{
    int err;
    ready_cb = cb;

    err = bt_init();
    if (ready_cb)
    {
        ready_cb(err);
    }

    return 0;
}

int auth_service_send(struct bt_conn *conn, const uint8_t *data, uint16_t len)
{
    if (len > 0)
    {
        return 0;
    }
    return -1;
}
```

## src/util_test_ble.h
```c
/*
 * Copyright (c) 
 *
 * SPDX-License-Identifier: Apache-2.0
 */

/// @file util_test_ble.h

#ifndef _UTIL_TEST_BLE_H
#define _UTIL_TEST_BLE_H

/* Standard and Zephyr libraries */
#include <zephyr.h>
#include <stdint.h>

/* Code tested */
#include "../../../../src/ble/ble_interface.h"

/************************************************
 *  ... FAKE
 ***********************************************/
/**
 * @brief Activate bt_conn_info function
 */
void set_bt_conn_info(void);
/**
 * @brief Deactivate bt_conn_info function
 */
void unset_bt_conn_info(void);

/** @brief Get connection info
 *
 *  @param conn Connection object.
 *  @param info Connection info object.
 *
 *  @return Zero on success or (negative) error code on failure.
 */
int bt_conn_get_info(const struct bt_conn *conn, struct bt_conn_info *info);

/** @brief Register connection callbacks.
 *
 *  Register callbacks to monitor the state of connections.
 *
 *  @param cb Callback struct. Must point to memory that remains valid.
 */
void bt_conn_cb_register(struct bt_conn_cb *cb);

/**
 * @brief Start advertising
 *
 * Set advertisement data, scan response data, advertisement parameters
 * and start advertising.
 *
 * When the advertisement parameter peer address has been set the advertising
 * will be directed to the peer. In this case advertisement data and scan
 * response data parameters are ignored. If the mode is high duty cycle
 * the timeout will be @ref BT_GAP_ADV_HIGH_DUTY_CYCLE_MAX_TIMEOUT.
 *
 * @param param Advertising parameters.
 * @param ad Data to be used in advertisement packets.
 * @param ad_len Number of elements in ad
 * @param sd Data to be used in scan response packets.
 * @param sd_len Number of elements in sd
 *
 * @return Zero on success or (negative) error code otherwise.
 * @return -ENOMEM No free connection objects available for connectable
 *                 advertiser.
 * @return -ECONNREFUSED When connectable advertising is requested and there
 *                       is already maximum number of connections established
 *                       in the controller.
 *                       This error code is only guaranteed when using Zephyr
 *                       controller, for other controllers code returned in
 *                       this case may be -EIO.
 */
int bt_le_adv_start(const struct bt_le_adv_param *param,
                    const struct bt_data *ad, size_t ad_len,
                    const struct bt_data *sd, size_t sd_len);

/**
 * @brief Stop advertising.
 * 
 * Stops ongoing advertising.
 * 
 * @return Zero on success or (negative) error code otherwise.
 */
int bt_le_adv_stop(void);

/** @brief Get destination (peer) address of a connection.
 *
 *  @param conn Connection object.
 *
 *  @return Destination address.
 */
const bt_addr_le_t *bt_conn_get_dst(const struct bt_conn *conn);

/** @brief Exchange MTU
 *
 *  This client procedure can be used to set the MTU to the maximum possible
 *  size the buffers can hold.
 *
 *  @note Shall only be used once per connection.
 *
 *  @param conn Connection object.
 *  @param params Exchange MTU parameters.
 *
 *  @return 0 in case of success or negative value in case of error.
 */
int bt_gatt_exchange_mtu(struct bt_conn *conn,
                         struct bt_gatt_exchange_params *params);

/**
 * @brief Enable Bluetooth
 *
 * Enable Bluetooth. Must be the called before any calls that
 * require communication with the local Bluetooth hardware.
 *
 * @param cb Callback to notify completion or NULL to perform the
 * enabling synchronously.
 *
 * @return Zero on success or (negative) error code otherwise.
 */
int bt_enable(bt_ready_cb_t cb);

/************************************************
 *  ... FAKE
 ***********************************************/

int auth_service_send(struct bt_conn *conn, const uint8_t *data, uint16_t len);

#endif /* _UTIL_TEST_BLE_H */
```
