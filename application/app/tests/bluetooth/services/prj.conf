## CMakeLists.txt
```
# SPDX-License-Identifier: Apache-2.0

cmake_minimum_required(VERSION 3.13.1)
find_package(Zephyr REQUIRED HINTS $ENV{ZEPHYR_BASE})
project(ble_services)

FILE(GLOB app_sources src/*.c)
target_sources(app PRIVATE ${app_sources})
```

## prj.conf
```kconfig
CONFIG_ZTEST=y
CONFIG_ZTEST_STACKSIZE=16384

CONFIG_TINYCRYPT=y
CONFIG_TINYCRYPT_SHA256=y
CONFIG_TINYCRYPT_SHA256_HMAC=y
CONFIG_TINYCRYPT_SHA256_HMAC_PRNG=y

#CONFIG_LOG=y
```

## src/main.c
```c
/*
 * Copyright (c) 
 *
 * SPDX-License-Identifier: Apache-2.0
 */

/// @file main.c

/**
 * @brief Tests for the ble services definitions
 *
 * Verify correct service definition
 *
 * @defgroup ble_services_tests SERV
 * @ingroup all_tests
 * @{
 * @}
 */

/* ZTEST library */
#include <ztest.h>

/************************************************
 *  ... TEST AUTHENTICATION SERVICE
 ***********************************************/
extern void test_auth_service_send(void);
extern void test_auth_service_send_bad_param(void);
extern void test_auth_service_send_not_sub(void);

extern void test_on_auth_received(void);

extern void test_cccd_changed_auth(void);
extern void test_cccd_changed_auth_disable(void);

/************************************************
 *  ... TEST MAIN
 ***********************************************/

/*test case main entry*/
void test_main(void)
{
    ztest_test_suite(test_services,
                     ztest_unit_test(test_auth_service_send),
                     ztest_unit_test(test_auth_service_send_bad_param),
                     ztest_unit_test(test_auth_service_send_not_sub),
                     ztest_unit_test(test_on_auth_received),
                     ztest_unit_test(test_cccd_changed_auth),
                     ztest_unit_test(test_cccd_changed_auth_disable));

    ztest_run_test_suite(test_services);
}
```

## src/test_authentication_service.c
```c
/*
 * Copyright (c) 
 *
 * SPDX-License-Identifier: Apache-2.0
 */

/// @file test_authentication_service.c

/**
 * @addtogroup ble_services_tests
 * @{
 */

/* ZTEST library */
#include <ztest.h>
#include <zephyr.h>
#include <stdint.h>

/* Fake functions */
#include "util_test_services.h"

/* Code tested */
#include "../../../../src/ble/services/authentication_service.c"
#include "../../../../src/ble/services/authentication_service.h"

/* FAKE CONNEXION */
static struct bt_conn *fakeconnexion;

/************************************************
 *  ...FAKE
 ***********************************************/
int get_secret_key(char stored_key[16])
{
    stored_key[16] = "aXs6h5cE9h0mDHr";
    return 0;
}

/************************************************
 *  ...TESTS DECLARATIONS
 ***********************************************/

/**
 * @brief Test Authentication attribute notification send
 * @details test auth_service_send() function.
 * @see auth_service_send()
 */
void test_auth_service_send(void)
{
    uint8_t fakedata = 0;
    uint16_t fakelen = 1;
    enable_notify();
    enable_param();
    zassert_ok(auth_service_send(fakeconnexion, &fakedata, fakelen),
               "Auth notification not sent");
}

/**
 * @brief Test Authentication attribute notification send fail
 * @details test auth_service_send() function.
 * @see auth_service_send()
 */
void test_auth_service_send_bad_param(void)
{
    uint8_t fakedata = 0;
    uint16_t fakelen = 1;
    enable_notify();
    disable_param();
    zassert_equal(auth_service_send(fakeconnexion, &fakedata, fakelen), -EINVAL,
                  "Auth notification sent but should not");
}

/**
 * @brief Test Authentication attribute notification no subscriber
 * @details test auth_service_send() function.
 * @see auth_service_send()
 */
void test_auth_service_send_not_sub(void)
{
    uint8_t fakedata = 0;
    uint16_t fakelen = 1;
    disable_notify();
    zassert_equal(auth_service_send(fakeconnexion, &fakedata, fakelen),
                  -ENOTCONN, "Auth notification subscribed but should not");
}

/**
 * @brief Test reception of authentication challenge
 * @details test on_receive_auth() callback function.
 * @see on_receive_auth()
 */
void test_on_auth_received(void)
{
    const struct bt_gatt_attr *fakeattr;
    const uint8_t buf[2] = {0, 1};
    uint16_t fakelen = 2;
    uint16_t fakeoffset = 0;
    uint8_t fakeflags = 0;

    zassert_equal(on_receive_auth(fakeconnexion, fakeattr,
                                  buf, fakelen, fakeoffset, fakeflags),
                  fakelen, "Auth received callback problem");
}

/**
 * @brief Test CCCD Authentication Notification enabled
 * @details test auth_ccc_cfg_changed() callback function.
 * @see auth_ccc_cfg_changed()
 */
void test_cccd_changed_auth(void)
{
    const struct bt_gatt_attr *fakeattr;
    uint16_t fakevalue = BT_GATT_CCC_NOTIFY;
    auth_ccc_cfg_changed(fakeattr, fakevalue);
    zassert_equal(0, 0, "Auth notification was not enabled");
}

/**
 * @brief Test CCCD Authentication Notification disabled
 * @details test auth_ccc_cfg_changed() callback function.
 * @see auth_ccc_cfg_changed()
 */
void test_cccd_changed_auth_disable(void)
{
    const struct bt_gatt_attr *fakeattr;
    uint16_t fakevalue = 0x0000;
    auth_ccc_cfg_changed(fakeattr, fakevalue);
    zassert_equal(0, 0, "Auth notification was not disabled");
}

/**
 * @}
 */
```

## src/util_test_services.c
```c
/*
 * Copyright (c) 
 *
 * SPDX-License-Identifier: Apache-2.0
 */

/// @file util_test_services.c

#include "util_test_services.h"

/******************************************************************************
 *** MOCK FUNCTIONS UTILITIES
 ******************************************************************************/

static bool notif_enabled;
static int notify_param;
static int indicate_enabled;

void enable_notify(void)
{
    notif_enabled = true;
}
void disable_notify(void)
{
    notif_enabled = false;
}

void enable_param(void)
{
    notify_param = 1;
}
void disable_param(void)
{
    notify_param = 0;
}

void enable_indicate(void)
{
    indicate_enabled = 0;
}

void disable_indicate(void)
{
    indicate_enabled = -1;
}

/******************************************************************************
 *** FAKE
 ******************************************************************************/

struct bt_conn *connection_get(void)
{
    struct bt_conn *fakeconnect;
    return fakeconnect;
}

/******************************************************************************
 *** STUBS
 ******************************************************************************/

ssize_t bt_gatt_attr_read(struct bt_conn *conn, const struct bt_gatt_attr *attr,
                          void *buf, uint16_t buf_len, uint16_t offset,
                          const void *value, uint16_t value_len)
{
    return buf_len;
}

ssize_t bt_gatt_attr_read_service(struct bt_conn *conn,
                                  const struct bt_gatt_attr *attr,
                                  void *buf, uint16_t len, uint16_t offset)
{
    return 0;
}

ssize_t bt_gatt_attr_read_chrc(struct bt_conn *conn,
                               const struct bt_gatt_attr *attr, void *buf,
                               uint16_t len, uint16_t offset)
{
    return 0;
}

ssize_t bt_gatt_attr_read_ccc(struct bt_conn *conn,
                              const struct bt_gatt_attr *attr, void *buf,
                              uint16_t len, uint16_t offset)
{
    return 0;
}

ssize_t bt_gatt_attr_write_ccc(struct bt_conn *conn,
                               const struct bt_gatt_attr *attr, const void *buf,
                               uint16_t len, uint16_t offset, uint8_t flags)
{
    return 0;
}

void hmac_compute(const char *host_challenge, uint16_t length_challenge,
                  uint8_t *result)
{
    return 0;
}

/******************************************************************************
 *** MOCKS
 ******************************************************************************/
bool bt_gatt_is_subscribed(struct bt_conn *conn,
                           const struct bt_gatt_attr *attr, uint16_t ccc_value)
{
    return notif_enabled;
}

int bt_gatt_notify_cb(struct bt_conn *conn,
                      struct bt_gatt_notify_params *params)
{
    if (notify_param > 0)
    {
        return 0;
    }
    else
    {
        return -1;
    }
}

int bt_gatt_indicate(struct bt_conn *conn,
                     struct bt_gatt_indicate_params *params)
{
    return indicate_enabled;
}
```

## src/util_test_services.h
```c
/*
 * Copyright (c) 
 *
 * SPDX-License-Identifier: Apache-2.0
 */

/// @file util_test_services.h

#ifndef _UTIL_TEST_SERVICES_H
#define _UTIL_TEST_SERVICES_H

/* Standard and Zephyr libraries */
#include <ztest.h>
#include <zephyr.h>
#include <stdint.h>
#include <logging/log.h>

#define CONFIG_BT_BAS_LOG_LEVEL LOG_LEVEL_ERR

#ifndef CONFIG_ARCH_POSIX
typedef int ssize_t;
#endif /* CONFIG_ARCH_POSIX */

/******************************************************************************
 *** MOCK FUNCTIONS UTILITIES
 ******************************************************************************/

void enable_notify(void);
void disable_notify(void);

void enable_param(void);
void disable_param(void);

void enable_indicate(void);
void disable_indicate(void);

/******************************************************************************
 *** FAKE
 ******************************************************************************/

struct bt_conn *connection_get(void);

#endif /* _UTIL_TEST_SERVICES_H */
```
