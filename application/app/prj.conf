## CMakeLists.txt
```
# Copyright (c) 2021 
# SPDX-License-Identifier: Apache-2.0

cmake_minimum_required(VERSION 3.13.1)
set(BOARD_ROOT ${CMAKE_CURRENT_LIST_DIR})

set(mcuboot_CONF_FILE
 ${CMAKE_CURRENT_SOURCE_DIR}/child_image/mcuboot.conf
)

find_package(Zephyr REQUIRED HINTS $ENV{ZEPHYR_BASE})

project(app LANGUAGES C VERSION 1.0.0)

target_include_directories(app PRIVATE ${CMAKE_BINARY_DIR}/app/include src)

FILE(GLOB main_sources src/*.c)
target_sources(app PRIVATE ${main_sources})

FILE(GLOB ble_sources src/ble/*.c)
target_sources(app PRIVATE ${ble_sources})

FILE(GLOB storage_sources src/settings/*.c)
target_sources(app PRIVATE ${storage_sources})

FILE(GLOB ble_services src/ble/services/*.c)
target_sources(app PRIVATE ${ble_services})

FILE(GLOB ble_authentication_sources src/ble/authentication/*.c)
target_sources(app PRIVATE ${ble_authentication_sources})

FILE(GLOB sensors_sources src/sensors/*.c)
target_sources(app PRIVATE ${sensors_sources})

FILE(GLOB battery_sources src/sensors/battery/*.c)
target_sources(app PRIVATE ${battery_sources})

add_subdirectory(drivers)

# Get current time
string(TIMESTAMP CURRENT_TIME %Y-%m-%dT%H:%M:%S)

# FW Version
set(SourceNcsVersionFile "${CMAKE_CURRENT_SOURCE_DIR}/info/fw_ncs_version.txt")
file(READ ${SourceNcsVersionFile} ncsver)

string(REGEX MATCH "NCS_MAJOR = ([0-9]*)" _ ${ncsver})
set(NCS_VERSION_MAJOR ${CMAKE_MATCH_1})

string(REGEX MATCH "NCS_MINOR = ([0-9]*)" _ ${ncsver})
set(NCS_VERSION_MINOR ${CMAKE_MATCH_1})

string(REGEX MATCH "NCS_PATCH = ([0-9]*)" _ ${ncsver})
set(NCS_VERSION_PATCH ${CMAKE_MATCH_1})

# SW Version
set(SourceVersionFile "${CMAKE_CURRENT_SOURCE_DIR}/info/sw_version.txt")
file(STRINGS ${SourceVersionFile} swver)

# Authentication key
set(SourceAuthFile "${CMAKE_CURRENT_SOURCE_DIR}/info/authentication_key.txt")
file(STRINGS ${SourceAuthFile} key)

# Get short commit hash
execute_process(
  COMMAND ${GIT_EXECUTABLE} describe --tags --dirty
  WORKING_DIRECTORY ${CMAKE_CURRENT_LIST_DIR}
  OUTPUT_VARIABLE FW_BUILD_GIT
  OUTPUT_STRIP_TRAILING_WHITESPACE
)
set(CMAKE_C_FLAGS "${CMAKE_C_FLAGS} \
                  -DCURRENT_TIME_OF_BUILD=\"${CURRENT_TIME}\" \
                  -DSECRET_KEY=\"${key}\" \
                  -DFW_BUILD=\"${NCS_VERSION_MAJOR}.${NCS_VERSION_MINOR}.${NCS_VERSION_PATCH}\" \
                  -DSW_REVISION=\"${swver}\" \
                  ")
```

## Kconfig
```
# Copyright (c) 2021 
# SPDX-License-Identifier: Apache-2.0
#
# This file is the application Kconfig entry point. All application Kconfig
# options can be defined here or included via other application Kconfig files.
# You can browse these options using the west targets menuconfig (terminal) or
# guiconfig (GUI).

menu "Zephyr"
source "Kconfig.zephyr"
endmenu

module = APP
module-str = APP
source "subsys/logging/Kconfig.template.log_config"

rsource "drivers/Kconfig"
```

## prj.conf
```kconfig
# Copyright (c) 2021 
# SPDX-License-Identifier: Apache-2.0

######################### BASIC CONFIGURATION #########################
#######################################################################
# Deactivate DEBUG/LOG for production builds
CONFIG_DEBUG=y
CONFIG_SERIAL=y
# Logging
CONFIG_LOG=y
CONFIG_UART_CONSOLE=y

# Unused peripherals
CONFIG_SPI=n

######################### Power Management ############################
#######################################################################
CONFIG_PM=y
CONFIG_PM_DEVICE=y

######################### RTOS ########################################
#######################################################################
# Some command handlers require a larger stack.
CONFIG_SYSTEM_WORKQUEUE_STACK_SIZE=2304
# Increases main stack size for accomodating IMG and OS Management.
CONFIG_MAIN_STACK_SIZE=2048
# Increases BT RX Stack size for managing BLE services
CONFIG_BT_RX_STACK_SIZE=2048

######################### SENSOR MODULE ###############################
#######################################################################
# Activate I2C and sensors connected to it
CONFIG_I2C=y
CONFIG_GPIO=y
CONFIG_SENSOR=y

######################### BLE MODULE ##################################
#######################################################################
# Activate the BLE layer, set as peripheral
CONFIG_BT=y
CONFIG_BT_SMP=y
CONFIG_BT_PERIPHERAL=y
CONFIG_BT_CTLR=y
CONFIG_BT_CTLR_PHY_2M=y
CONFIG_BT_GATT_CLIENT=y

# Set up the Battery Service
CONFIG_BT_BAS=y

# Set up device name and appearance
CONFIG_BT_DEVICE_NAME="Z-Wear"
# Appearance 833 is Heart rate belt
CONFIG_BT_DEVICE_APPEARANCE=833

# Default BLE Radio transmit power level in dBm
CONFIG_BT_CTLR_TX_PWR_0=y

# Set up the Device Information Service
CONFIG_BT_DIS=y
CONFIG_BT_DIS_PNP=n
CONFIG_BT_DIS_MANUF="Dummy"
CONFIG_BT_DIS_MODEL="Z-Wear"
CONFIG_BT_DIS_SERIAL_NUMBER=y
CONFIG_BT_DIS_SERIAL_NUMBER_STR="SerialNumber"
CONFIG_BT_DIS_FW_REV=y
CONFIG_BT_DIS_SW_REV=y
CONFIG_BT_DIS_HW_REV=y
CONFIG_BT_DIS_HW_REV_STR="Dummy"

# Let DIS information be read from settings
CONFIG_BT_SETTINGS=y
CONFIG_SETTINGS_RUNTIME=y
CONFIG_SETTINGS=y
CONFIG_BT_DIS_SETTINGS=y
CONFIG_BT_DIS_STR_MAX=25

# ATT and L2CAP buffers
CONFIG_BT_ATT_PREPARE_COUNT=4
CONFIG_BT_L2CAP_TX_BUF_COUNT=4
CONFIG_BT_CTLR_RX_BUFFERS=4

# Extends the L2CAP MTU for TX and RX
# To obtain the value needed for TX and RX:
# For TX use L2CAP_TX_MTU directly, but it is not directly configurable for RX
# For RX, BT_L2CAP_HDR_SIZE is 4 and L2CAP_RX_MTU = BUF_ACL_RX_SIZE-4
CONFIG_BT_L2CAP_TX_MTU=252
CONFIG_BT_BUF_ACL_RX_SIZE=256

# Enable support for LE Connection oriented channels
# This alloys the creation of dynamic L2CAP channels
CONFIG_BT_L2CAP_DYNAMIC_CHANNEL=y

# Allow another device that unpaired to pair again
CONFIG_BT_SMP_ALLOW_UNAUTH_OVERWRITE=y

######################### SETTINGS MODULE #############################
#######################################################################
# Storage of parameters
CONFIG_FLASH=y
CONFIG_FLASH_PAGE_LAYOUT=y
CONFIG_FLASH_MAP=y

CONFIG_STDOUT_CONSOLE=n
CONFIG_NVS=y
CONFIG_SETTINGS_NVS=y
CONFIG_ARM_MPU=n

######################### AUTHENTICATION MODULE #######################
#######################################################################
# Encryption with tinycrypt library
CONFIG_ENTROPY_GENERATOR=y
CONFIG_TINYCRYPT=y
CONFIG_TINYCRYPT_SHA256=y
CONFIG_TINYCRYPT_SHA256_HMAC=y

######################### SECURITY MANAGER PROTOCOL MODULE ############
######################### BOOTLOADER ##################################
#######################################################################
# Enable mcumgr.
CONFIG_MCUMGR=y
# Ensure an MCUboot-compatible binary is generated. MCUboot is the upgradable bootloader.
CONFIG_BOOTLOADER_MCUBOOT=y
# Enable most core commands.
CONFIG_MCUMGR_CMD_IMG_MGMT=y
CONFIG_MCUMGR_CMD_OS_MGMT=y
# Enable the Bluetooth (unauthenticated) mcumgr transports.
CONFIG_MCUMGR_SMP_BT=y
CONFIG_MCUMGR_SMP_BT_AUTHEN=n
# Generate a confirmed image directly
CONFIG_MCUBOOT_GENERATE_CONFIRMED_IMAGE=y
```

## dts/bindings/sensor/mcube,mc3672.yaml
```yaml
# Copyright (c) 2019 Nordic Semiconductor ASA
# SPDX-License-Identifier: Apache-2.0

description: MC3672 3-axis accelerometer device

compatible: "mcube,mc3672"

include: i2c-device.yaml

properties:
    int-gpios:
      type: phandle-array
      required: false
      description: |
        The INT signal default configuration is active-high.  The
        property value should ensure the flags properly describe the
        signal that is presented to the driver.
```

## dts/bindings/sensor/onnn,lc709204.yaml
```yaml
#
# Copyright (c) 2020 Linumiz
#
# SPDX-License-Identifier: Apache-2.0
#

description: ON Semiconductor LC709204 Fuel Gauge

compatible: "onnn,lc709204"

include: i2c-device.yaml

properties:
    design-voltage:
      type: int
      required: true
      description: Battery Design Voltage in mV (3300 - 4400)

    design-capacity:
      type: int
      required: true
      description: Battery Design Capacity in mAh

    terminate-voltage:
      type: int
      required: true
      description: Battery Terminate Voltage in mV

    tsense1-b-constant:
      type: int
      required: true
      description: B constant for the NTC resistor on TSENSE1

    alarm-gpios:
      type: phandle-array
      required: false
      description: |
        Description of this pin. ALARM_GAUGE
```

## dts/bindings/sensor/ti,ldc1612.yaml
```yaml
# Copyright (c) 2019 Nordic Semiconductor ASA
# SPDX-License-Identifier: Apache-2.0

description: TI LDC1612 Inductance sensor device

compatible: "ti,ldc1612"

include: i2c-device.yaml

properties:
    int-gpios:
      type: phandle-array
      required: false
      description: |
        The INT signal default configuration is active-high.  The
        property value should ensure the flags properly describe the
        signal that is presented to the driver.

    sd-gpios:
      type: phandle-array
      required: false
      description: |
        Description of this pin. Active-low.

    clk-st-gpios:
      type: phandle-array
      required: false
      description: |
        Description of this pin. Active-high.
```

## src/main.c
```c
/*
 * Copyright (c) 2021
 *
 * SPDX-License-Identifier: Apache-2.0
 */

/** 
 * @file main.c
 * @defgroup main Main: Z-Wear main thread process.
 * @brief Main thread.
 */

/* Standard and Zephyr libraries */
#include <zephyr.h>
#include <stdio.h>

/* BLE Interface functions */
#include "ble/ble_interface.h"

/* Sensor interface functions */
#include "sensors/sensor_interface.h"

/* Settings Interface functions */
#include "settings/settings_storage.h"

/* Logging module */
#include <logging/log.h>
LOG_MODULE_REGISTER(main, LOG_LEVEL_ERR);

#ifdef CONFIG_MCUMGR_CMD_OS_MGMT
#include "os_mgmt/os_mgmt.h"
#endif
#ifdef CONFIG_MCUMGR_CMD_IMG_MGMT
#include "img_mgmt/img_mgmt.h"
#endif
#ifdef CONFIG_MCUMGR_SMP_BT
#include <mgmt/mcumgr/smp_bt.h>
#endif

#if defined(CONFIG_ZTEST)
int main_posix(void)
#else
int main(void)
#endif
{
/* Register the built-in mcumgr command handlers. */
#ifdef CONFIG_MCUMGR_CMD_OS_MGMT
    os_mgmt_register_group();
#endif
#ifdef CONFIG_MCUMGR_CMD_IMG_MGMT
    img_mgmt_register_group();
#endif

    int err = -1;

    /* Initialize the storage */
    err = storage_initialization();
    if (err)
    {
        LOG_ERR("Storage initialization failed, err %d", err);
        return err;
    }

    /* Initialize the BLE layer */
    err = ble_layer_init();
    if (err)
    {
        LOG_ERR("BLE initialization failed, err %d", err);
        return err;
    }
    LOG_INF("BLE initialization successful");

#ifdef CONFIG_MCUMGR_SMP_BT
    /* Initialize the Bluetooth mcumgr transport. */
    smp_bt_register();
#endif

    /* Initialize the battery sensor handler */
    err = bas_init();
    if (err)
    {
        LOG_ERR("Battery sensor handler did not initialize, err %d", err);
        return err;
    }

    /* Initialize the BLE timeout for no connection */
    err = ble_timeout_start();
    if (err)
    {
        LOG_ERR("BLE timeout did not initialize, err %d", err);
        return err;
    }

    while (1)
    {
#if defined(CONFIG_ARCH_POSIX)
        return 0;
#endif
        /* Sleeps to let the idle thread running */
        k_sleep(K_FOREVER);
    }
    return 0;
}
```

## src/version.h
```c
/*
 * Copyright (c) 2021
 *
 * SPDX-License-Identifier: Apache-2.0
 */

#ifndef VERSION__H
#define VERSION__H

/* Stringify firmware build data included by cmake */
#define _xstr(s) _str(s)
#define _str(s) #s
#define TIME_OF_BUILD _xstr(CURRENT_TIME_OF_BUILD)
#define FW_VERSION _xstr(FW_BUILD)
#define SW_VERSION _xstr(SW_REVISION)

/* Stringify secret key data included by cmake */
#define SECRET_AUTH_KEY _xstr(SECRET_KEY)

#endif /* VERSION__H */
```
