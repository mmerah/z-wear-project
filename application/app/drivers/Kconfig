## application/app/drivers/lc709204/Kconfig
```kconfig
# Copyright (c) 2021 
#
# SPDX-License-Identifier: Apache-2.0

menuconfig LC709204
	bool "LC709204 Fuel Gauge"
	depends on I2C
	help
	  Enable I2C-based driver for LC709204 Fuel Gauge.
```

## application/app/drivers/ldc1612/Kconfig
```kconfig
# SPDX-License-Identifier: Apache-2.0

menuconfig LDC1612
	bool "LDC1612 I2C inductance sensor driver"
	depends on I2C
	help
	  Enable driver for LDC1612 inductance sensor drive

config LDC1612_TRIGGER
	bool
```

## application/app/drivers/mc3672/Kconfig
```kconfig
# SPDX-License-Identifier: Apache-2.0

menuconfig MC3672
	bool "MC3672 3-Axis Accelerometer Device"
	depends on I2C
	help
	  Enable driver for MC3672 I2C-based 3-axis accelerometer device.

if MC3672

choice
	prompt "Trigger mode"
	default MC3672_TRIGGER_GLOBAL_THREAD
	help
	  Specify the type of triggering to be used by the driver.

config MC3672_TRIGGER_NONE
	bool "No trigger"

config MC3672_TRIGGER_GLOBAL_THREAD
	bool "Use global thread"
	depends on GPIO
	select MC3672_TRIGGER

config MC3672_TRIGGER_OWN_THREAD
	bool "Use own thread"
	depends on GPIO
	select MC3672_TRIGGER

endchoice

config MC3672_TRIGGER
	bool

config MC3672_THREAD_PRIORITY
	int "Thread priority"
	depends on MC3672_TRIGGER_OWN_THREAD
	default 10
	help
	  Priority of thread used by the driver to handle interrupts.

config MC3672_THREAD_STACK_SIZE
	int "Thread stack size"
	depends on MC3672_TRIGGER_OWN_THREAD
	default 512
	help
	  Stack size of thread used by the driver to handle interrupts.

config MC3672_ACCEL_FS
	int "Accelerometer full-scale range"
	default 2
	help
	  Magnetometer full-scale range.
	  An X value for the config represents a range of +/- X g. Valid
	  values are 2, 4, 8 and 16.

endif # MC3672
```

## application/app/tests/authentication/testcase.yaml
```yaml
tests:
  # section.subsection
  authentication.hmac:
    tags: tinycrypt crypto sha256
    platform_allow: native_posix nrf52840dk_nrf52840
```

## application/app/tests/bluetooth/interface/testcase.yaml
```yaml
tests:
  # section.subsection
  bluetooth.interface:
    tags: bluetooth ble init
    platform_allow: native_posix nrf52840dk_nrf52840
```

## application/app/tests/bluetooth/services/testcase.yaml
```yaml
tests:
  # section.subsection
  bluetooth.services:
    tags: bluetooth ble services
    platform_allow: native_posix nrf52840dk_nrf52840
```

## application/app/tests/sensors/battery/testcase.yaml
```yaml
tests:
  # section.subsection
  sensors.battery:
    tags: sensor hal battery
    platform_allow: native_posix nrf52840dk_nrf52840
```

## application/app/tests/sensors/interface/testcase.yaml
```yaml
tests:
  # section.subsection
  sensors.interface:
    tags: sensor hal
    platform_allow: native_posix nrf52840dk_nrf52840
```

## application/app/tests/settings/storage/testcase.yaml
```yaml
tests:
  # section.subsection
  settings.storage:
    tags: settings storage nvs
    platform_allow: native_posix nrf52840dk_nrf52840
```
